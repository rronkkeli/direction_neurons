## CMakeLists.txt
```
# SPDX-License-Identifier: Apache-2.0

cmake_minimum_required(VERSION 3.20.0)

find_package(Zephyr HINTS $ENV{ZEPHYR_BASE})
project(ADC)

target_sources(app PRIVATE src/main.c)
target_sources(app PRIVATE src/adc.c)
target_sources(app PRIVATE src/confusion.c)
target_sources(app PRIVATE src/central_points.c)
target_sources(app PRIVATE src/neural_net.c)
```

## prj.conf
```kconfig
# Logger module
CONFIG_LOG=y

# Button and LED library   
CONFIG_DK_LIBRARY=y

# ADC library
CONFIG_ADC=y

# math.h, pow and sqrt functions
CONFIG_NEWLIB_LIBC=y

# Floating point
CONFIG_FPU=y
CONFIG_DOUBLE_PRECISION_FPU=y
```

## src/main.c
```c
/*
 * Copyright (c) 2020 Libre Solar Technologies GmbH
 *
 * SPDX-License-Identifier: Apache-2.0
 */
#include <zephyr/logging/log.h>
#include <dk_buttons_and_leds.h>
#include <inttypes.h>
#include <stddef.h>
#include <stdint.h>
#include <zephyr/kernel.h>
#include <zephyr/sys/printk.h>
#include <zephyr/sys/util.h>
#include "adc.h"
#include <zephyr/device.h>
#include <zephyr/devicetree.h>

#include "confusion.h"



#define USER_LED1         	 	DK_LED1
#define USER_LED2          		DK_LED2
#define USER_LED3               DK_LED3
#define USER_LED4               DK_LED4

#define USER_BUTTON_1           DK_BTN1_MSK
#define USER_BUTTON_2           DK_BTN2_MSK
#define USER_BUTTON_3           DK_BTN3_MSK
#define USER_BUTTON_4           DK_BTN4_MSK

#define DEBUG 0  // 0 = changes direction when button 3 is pressed
                 // 1 = fake 100 measurements done to each 6 directions when 3 pressed.
static int direction = -1;	// 0 = x direction high
							// 1 = x directon low	
							// 2 = y direction high
							// 3 = y direction low
							// 4 = z direction high
							// 5 = z direction low
                				 

LOG_MODULE_REGISTER(MAIN, LOG_LEVEL_INF);

static void button_changed(uint32_t button_state, uint32_t has_changed)
{
	//printk("button_state = %d\n",button_state);
	//printk("has_changed = %d\n",has_changed);
	if ((has_changed & USER_BUTTON_1) && (button_state & USER_BUTTON_1)) 
	{
		printk("Button 1 down, printing current Confusion Matrix\n");
		printConfusionMatrix();
	}

	if ((has_changed & USER_BUTTON_2) && (button_state & USER_BUTTON_2)) 
	{
		printk("Button 2 down, resetting confusion matrix\n");
		resetConfusionMatrix();
		printConfusionMatrix();
	}		
	
	if ((has_changed & USER_BUTTON_3) && (button_state & USER_BUTTON_3)) 
	{
		// printk("Button 3 down, making fake 100 meas or one real meas depending on DEBUG state\n");
		#if DEBUG
		direction = 0;
		makeHundredFakeClassifications();
		printConfusionMatrix();
		#else
        direction = (direction +1)%6;
		switch (direction)
		{
		case 0:
			printk("Direction is now set x = low\n");
			break;
		case 1:
			printk("Direction is now set x = high\n");
			break;
		case 2:
			printk("Direction is now set y = low\n");
			break;
		case 3:
			printk("Direction is now set y = high\n");
			break;
		case 4:
			printk("Direction is now set z = low\n");
			break;
		case 5:
			printk("Direction is now set z = high\n");
			break;
		
		default:
		    printk("Wrong direction set!!!\n");
			break;
		}

		struct Measurement m = readADCValue();
		printk("x = %d,  y = %d,  z = %d\n",m.x,m.y,m.z);

		#endif
	}		

	if ((has_changed & USER_BUTTON_4) && (button_state & USER_BUTTON_4)) 
	{
		printk("button 4 down, one meas and classification with current direction =%d\n",direction);
		makeOneClassificationAndUpdateConfusionMatrix(direction);
		printConfusionMatrix();
	}		
}


int main(void)
{
	int err;
	err = dk_leds_init();
	if (err) {
		LOG_ERR("LEDs init failed (err %d)\n", err);
		return 1;
	}

	err = dk_buttons_init(button_changed);
	if (err) {
		printk("Cannot init buttons (err: %d)\n", err);
		return 1;
	}
	
	
	if(initializeADC() != 0)
	{
		printk("ADC initialization failed!");
		return 1;
	}

	while (1) 
	{
		//struct Measurement m = readADCValue();
		//printk("x = %d,  y = %d,  z = %d\n",m.x,m.y,m.z);
		
		k_sleep(K_MSEC(1000));
		
		dk_set_led_on(USER_LED1);
		dk_set_led_on(USER_LED2);
		dk_set_led_on(USER_LED3);
		dk_set_led_on(USER_LED4);
		 
		k_sleep(K_MSEC(1000));
		
		dk_set_led_off(USER_LED1);
		dk_set_led_off(USER_LED2);
		dk_set_led_off(USER_LED3);
		dk_set_led_off(USER_LED4);


	}

	return 0;
}
```

## src/central_points.c
```c
#include "central_points.h"

int cp[6][3] = {
    {1332, 1647, 1698},
    {1976, 1644, 1654},
    {1641, 1318, 1651},
    {1662, 1969, 1655},
    {1677, 1689, 1350},
    {1663, 1636, 2002}
};
```

## src/central_points.h
```c
#ifndef CENTRAL_POINTS_H
#define CENTRAL_POINTS_H

extern int cp[6][3];

#endif
```

## src/confusion.c
```c
#include <zephyr/kernel.h>
#include <math.h>
#include "confusion.h"
#include "adc.h"
#include "central_points.h"
#include "neural_net.h"

const bool USE_NEURAL_NET = false;

/* 
  K-means algorithm should provide 6 center points with
  3 values x,y,z. Let's test measurement system with known
  center points. I.e. x,y,z are supposed to have only values
  1 = down and 2 = up
  
  CP matrix is thus the 6 center points got from K-means algoritm
  teaching process. This should actually come from include file like
  #include "KmeansCenterPoints.h"
  
  And measurements matrix is just fake matrix for testing purpose
  actual measurements are taken from ADC when accelerator is connected.
*/

// How many measurements should be taken when command is given?
const int MEASUREMENT_COUNT = 10000;

/*

*/
int CM[6][6]= {0};
float dense_layer_neurons[1][64];
float output_layer_neurons[1][6];

void printConfusionMatrix(void)
{
	printk("Confusion matrix = \n");
	printk("    cp1    cp2    cp3    cp4    cp5    cp6\n");
	for(int i = 0; i < 6; i++)
	{
		printk("cp%d %d      %d      %d      %d      %d      %d\n", i+1, CM[i][0], CM[i][1], CM[i][2], CM[i][3], CM[i][4], CM[i][5]);
	}
}

void makeHundredFakeClassifications(void)
{
   /*******************************************
   Jos ja toivottavasti kun teet toteutuksen paloissa eli varmistat ensin,
   että etäisyyden laskenta 6 keskipisteeseen toimii ja osaat valita 6 etäisyydestä
   voittajaksi sen lyhyimmän etäisyyden, niin silloin voit käyttää tätä aliohjelmaa
   varmistaaksesi, että etäisuuden laskenta ja luokittelu toimii varmasti tunnetulla
   itse keksimälläsi sensoridatalla ja itse keksimilläsi keskipisteillä.
   *******************************************/
   printk("Make your own implementation for this function if you need this\n");
}

/*
   Takes the intented direction and increments its corresponding
   row in the confusion matrix
*/
void makeOneClassificationAndUpdateConfusionMatrix(int direction)
{
   /**************************************
   Tee toteutus tälle ja voit tietysti muuttaa tämän aliohjelman sellaiseksi,
   että se tekee esim 100 kpl mittauksia tai sitten niin, että tätä funktiota
   kutsutaan 100 kertaa yhden mittauksen ja sen luokittelun tekemiseksi.
   **************************************/
   struct Measurement m;
   int winner;

   for (int i = 0; i < MEASUREMENT_COUNT; i++) {
      m = readADCValue();

      if (USE_NEURAL_NET) {
         printk("C: %d %d %d", m.x, m.y, m.z);
         winner = neuralNetDir(m.x, m.y, m.z);
      } else {
         winner = calculateDistanceToAllCentrePointsAndSelectWinner(m.x, m.y, m.z);
      }

      CM[direction][winner]++;
   }
}

/*
   Calculates the distance to all central points and selects the closest point
   the winner of the point. Takes coordinates of the point as parameters.
*/
int calculateDistanceToAllCentrePointsAndSelectWinner(int x, int y, int z)
{
   int winner = 0;
   float shortest = sqrt(powf(x - cp[0][0], 2.0) + powf(y - cp[0][1], 2.0) + powf(z - cp[0][2], 2.0));

   for (int i = 1; i < 6; i++) {
      float distance = sqrt(powf(x - cp[i][0], 2.0) + powf(y - cp[i][1], 2.0) + powf(z - cp[i][2], 2.0));

      if (distance < shortest) {
         winner = i;
         shortest = distance;
      }
   }

   return winner;
}

void resetConfusionMatrix(void)
{
	for(int i=0;i<6;i++)
	{ 
		for(int j = 0;j<6;j++)
		{
			CM[i][j]=0;
		}
	}
}

int neuralNetDir(int x, int y, int z) {
   // Esikäsittele koordinaatit
   int middle = 0;
   if ((x <= y && x >= z) || (x >= y && x <= z)) {
      middle = x;
   } else if ((y <= x && y >= z) || (y >= x && y <= z)) {
      middle = y;
   }  else if ((z <= x && z >= y) || (z >= x && z <= y)) {
      middle = z;
   }

   x -= middle;
   y -= middle;
   z -= middle;

   resetNeurons();
   // printk("Dense layer first element: %f\n", dense_layer_neurons[0][0]);
   float v[1][3] = {{x, y, z}};
   middlemise(v);
   // neuralNetDense(v);
   // printk("Dense layer first element: %f\n", dense_layer_neurons[0][0]);
   float output[6];
   neuralNetOut(v, output);
   float max = 0;
   int win = 0;

   for (int i = 0; i < 6; i++) {
      if (output_layer_neurons[0][i] > max) {
         win = i;
         max = output_layer_neurons[0][i];
      }
   }

   printk("Winner was %d\n", win);

   return win;
}

void neuralNetOut(float values[1][3], float *output) {
   for (int i = 0; i < 6; i++) {
      for (int j = 0; j < 3; j++) {
         output_layer_neurons[0][i] += (values[0][j] * w_dense[j][i]);
      }

      output_layer_neurons[0][i] += b_dense[i][0];
   }

   softmax(output_layer_neurons[0], 6, output);

   for (int i = 0; i < 6; i++) {
      output_layer_neurons[0][i] = output[i];
   }
}

void resetNeurons() {
   for (int i = 0; i < 6; i++) {
      output_layer_neurons[0][i] = 0.;
   }
}

double sigmoid(double value) {
   float sig = 1.0 / (1.0 + expf(-value));

   printk("Sigmoid result of value %f: %f\n", value, sig);
   return sig;
}

float relu(float x) {
   if (x < 0.0f) {
      return 0.0f;
   } else {
      return x;
   }
}

void middlemise(float x[1][3]) {
   int middle = 2;
   if ((x[0][0] <= x[0][1] && x[0][0] >= x[0][2]) || (x[0][0] >= x[0][1] && x[0][0] <= x[0][2])) {
      middle = 0;
   } else if ((x[0][1] <= x[0][0] && x[0][1] >= x[0][2]) || (x[0][1] >= x[0][0] && x[0][1] <= x[0][2])) {
      middle = 1;
   }  else if ((x[0][2] <= x[0][0] && x[0][2] >= x[0][1]) || (x[0][2] >= x[0][0] && x[0][2] <= x[0][1])) {
      middle = 2;
   }

   x[0][0] -= x[0][middle];
   x[0][1] -= x[0][middle];
   x[0][2] -= x[0][middle];
}

void softmax(float *input, int input_len, float *output) {
  float max_val = input[0];
  for (int i = 1; i < input_len; i++) {
    if (input[i] > max_val) {
      max_val = input[i];
    }
  }

  float sum_exp = 0.0f;
  for (int i = 0; i < input_len; i++) {
    output[i] = expf(input[i] - max_val); // Subtract max for numerical stability
    sum_exp += output[i];
  }

  for (int i = 0; i < input_len; i++) {
    output[i] /= sum_exp;
  }
}
```

## src/confusion.h
```c
#ifndef CONFUSION_MATRIX_H
#define CONFUSION_MATRIX_H


void printConfusionMatrix(void);
void makeHundredFakeClassifications(void);
void makeOneClassificationAndUpdateConfusionMatrix(int);
int calculateDistanceToAllCentrePointsAndSelectWinner(int,int,int);
void resetConfusionMatrix(void);
int neuralNetDir(int, int, int);
void neuralNetOut(float[1][3], float*);
double sigmoid(double);
float relu(float);
void resetNeurons(void);
void middlemise(float[1][3]);
void softmax(float*, int, float*);

#endif
```

## src/neural_net.c
```c
// Tämä on Aapon python-skriptin tuottama c-tiedosto
// Kitinöistä sakotetaan

#include "neural_net.h"

float w_dense[3][6] = {
    {-0.03807948, 0.08930596, -0.00039951174, 0.00049179874, -0.021493318, 0.00091977854},
    {-0.00024121156, 0.00096035167, -0.0143023655, 0.02259095, -0.003116586, 0.00066372554},
    {-0.0009162985, 0.0009118653, -0.001414893, 0.0012012003, -0.08915179, 0.0102264695}
};

float b_dense[6][1] = {
    {-0.66881484},
    {-0.6862703},
    {-0.7240473},
    {-0.64825237},
    {-0.6777576},
    {-0.6860564}
};
```

## src/neural_net.h
```c
// Tämä on Aapon python-skriptin tuottama h-tiedosto
// Kitinöistä sakotetaan

#ifndef NEURAL_NET_H
#define NEURAL_NET_H

extern float w_dense[3][6] ;
extern float b_dense[6][1];

#endif
```
